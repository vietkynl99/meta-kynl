## conf/layer.conf
```bitbake
# We have a conf and classes directory, add to BBPATH
BBPATH .= ":${LAYERDIR}"

# We have recipes-* directories, add to BBFILES
BBFILES += "${LAYERDIR}/recipes-*/*/*.bb \
            ${LAYERDIR}/recipes-*/*/*.bbappend"

BBFILE_COLLECTIONS += "meta-kynl"
BBFILE_PATTERN_meta-kynl = "^${LAYERDIR}/"
BBFILE_PRIORITY_meta-kynl = "6"

LAYERDEPENDS_meta-kynl = "core"
LAYERSERIES_COMPAT_meta-kynl = "dunfell"
```
